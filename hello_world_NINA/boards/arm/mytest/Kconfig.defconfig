## hello_world_NINA/boards/arm/mytest/Kconfig.defconfig
```kconfig
# Copyright (c) 2023 Nordic Semiconductor ASA
# SPDX-License-Identifier: Apache-2.0

if BOARD_MYTEST

config BOARD
	default "mytest"

config BT_CTLR
   default BT

endif
```

## hello_world_NINA/boards/arm/sf_nina/Kconfig.board
```kconfig
# Copyright (c) 2023 Nordic Semiconductor ASA
# SPDX-License-Identifier: Apache-2.0

config BOARD_SF_NINA
	bool "sf_nina"
	depends on SOC_NRF52840_QIAA
```

## hello_world_NINA/boards/arm/sf_nina/Kconfig.defconfig
```kconfig
# Copyright (c) 2023 Nordic Semiconductor ASA
# SPDX-License-Identifier: Apache-2.0

if BOARD_SF_NINA

config BOARD
	default "sf_nina"

config BT_CTLR
   default BT

endif
```

## i2c_accel/build/Kconfig/Kconfig.shield.defconfig
```kconfig
osource "/home/saul/projects/others/bt-fund/lesson4/blefund_less4_exer3/boards/shields/*/Kconfig.defconfig"
osource "/home/saul/projects/nordic_bk/blefund_less4_exer3_solution/boards/shields/*/Kconfig.defconfig"
osource "/home/saul/projects/nordic_work/ble_uart1/boards/shields/*/Kconfig.defconfig"
osource "/home/saul/installs/nordic/ncs/v2.3.0/nrf/boards/shields/*/Kconfig.defconfig"
```

## vr_2_4_1_NINA/boards/arm/boards/arm/elintronicsvr/Kconfig.defconfig
```kconfig
# Copyright (c) 2023 Nordic Semiconductor ASA
# SPDX-License-Identifier: Apache-2.0

if BOARD_ELINTRONICSVR

config BOARD
	default "elintronicsvr"

config BT_CTLR
   default BT

endif
```

## vr_mouse/build/Kconfig/Kconfig.shield.defconfig
```kconfig
osource "/home/saul/projects/nordic_work/nordic_ble_nus_test/boards/shields/*/Kconfig.defconfig"
osource "/home/saul/installs/nordic/ncs/v2.4.0/nrf/boards/shields/*/Kconfig.defconfig"
```
